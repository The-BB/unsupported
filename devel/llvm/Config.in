## devel/llvm/Config.in
```kconfig
config LLVM_TARGET_ARCH
	string
	default "AArch64" if aarch64
	default "ARM" if arm
	default "Mips" if (mips||mipsel)
	default "X86" if (i386||x86_64)

config LLVM_RTTI
	bool "Enable run time type information (RTTI)"
	default n
	help
		Build LLVM with run-time type information. LLVM can be built
		without rtti, but turning it off changes the ABI of C++
		programs.

		This features is needed to build the Gallium Nouveau driver
		or the Clover OpenCL state tracker when llvm support is
		enabled.

		https://llvm.org/docs/HowToSetUpLLVMStyleRTTI.html

comment "LLVM backends"

config LLVM_AMDGPU
	bool "AMDGPU backend"
	default n
	help
		Build AMDGPU target.

config LLVM_BPF
	bool "BPF backend"
	default n
	help
		Build BPF target.

config LLVM_WEBASSEMBLY
	bool "WebAssembly backend"
	default n
	help
		Build WebAssembly target (WASM).
```

## libs/cairo/Config.in
```kconfig
if PACKAGE_libcairo

comment "Build Options"

	config CAIRO_FONTCONFIG
		bool "Fontconfig font backend for cairo graphics library"

	config CAIRO_FREETYPE
		bool "Freetype font backend for cairo graphics library"

	config CAIRO_GLIB2
		bool "cairo-gobject for cairo graphics library"

	config CAIRO_PNG
		bool "PNG/SVG surface backend for cairo graphics library"

endif
```

## libs/harfbuzz/Config.in
```kconfig
if PACKAGE_libharfbuzz

comment "Build Options"

	config HARFBUZZ_CAIRO
		bool "Use Cairo graphics library"

	config HARFBUZZ_FREETYPE
		bool "Enable freetype interop helpers"
		select HARFBUZZ_GLIB2

	config HARFBUZZ_GLIB2
		bool "Enable GLib unicode functions"

	config HARFBUZZ_ICU
		bool "Enable ICU library unicode functions"

endif
```

## libs/kronosnet/Config.in
```kconfig
if PACKAGE_libknet

comment "Build Options"

	config KRONOSNET_COMPRESS_BZIP2
		bool "Enable libknet bzip2 support"
		help
		    Provides bzip2 compression support for libknet.

	config KRONOSNET_COMPRESS_LZ4
		bool "Enable libknet lz4 support"
		help
		    Provides lz4 and lz4hc compression support for libknet.

	config KRONOSNET_COMPRESS_LZMA
		bool "Enable libknet lzma support"
		help
		    Provides lzma compression support for libknet.

	config KRONOSNET_COMPRESS_LZO2
		bool "Enable libknet lzo2 support"
		help
		    Provides lzo2 compression support for libknet.

	config KRONOSNET_COMPRESS_ZLIB
		bool "Enable libknet zlib support"
		help
		    Provides zlib compression support for libknet.

	config KRONOSNET_COMPRESS_ZSTD
		bool "Enable libknet zstd support"
		help
		    Provides zstd compression support for libknet.

	config KRONOSNET_CRIPTO_NSS
		bool "Enable libknet nss support"
		help
		    Provides NSS crypto support for libknet.

	config KRONOSNET_CRIPTO_OPENSSL
		bool "Enable libknet openssl support"
		help
		    Provides OpenSSL crypto support for libknet.

	config KRONOSNET_INSTALL_TESTS
		bool "Install tests"
		help
		    Provides all the libknet and libnozzle test suite.

endif
```

## libs/libopenmpt/Config.in
```kconfig
if PACKAGE_libopenmpt

comment "libopenmpt Library Configuration"

	config LIBOPENMPT_MPG123
		bool "Enable use of libmpg123"
		default y

	config LIBOPENMPT_OGG
		bool "Enable use of libogg"
		default y

	config LIBOPENMPT_VORBIS
		bool "Enable use of libvorbis"
		default y

	config LIBOPENMPT_VORBISFILE
		bool "Enable use of libvorbisfile" if LIBOPENMPT_VORBIS
		default y

	config LIBOPENMPT_ZLIB
		bool "Enable use of zlib"
		default y

	config LIBOPENMPT_OPENMPT123
		bool "Enable the openmpt123 command line player"
		default n

endif
```

## libs/pango/Config.in
```kconfig
if PACKAGE_libpango

comment "Build Options"

	config PANGO_CAIRO
		bool "Build with cairo support"
		select CAIRO_FONTCONFIG
		select CAIRO_FREETYPE
		select CAIRO_PNG

endif
```

## libs/sdl2/Config.in
```kconfig
if PACKAGE_libsdl2

comment "Build Options"

config LIBSDL2_ALSA
	depends on PACKAGE_libsdl2
	bool "Support the ALSA audio API"
	default y

config LIBSDL2_DBUS
	depends on PACKAGE_libsdl2
	bool "Enable D-Bus support"
	default y

config LIBSDL2_UDEV
	depends on PACKAGE_libsdl2
	bool "Enable libudev support"
	default y

endif
```

## mmedia/pipewire/Config.in
```kconfig
if PACKAGE_pipewire

comment "Build Options"

	config PIPEWIRE_AVAHI_LIBAVAHI_CLIENT
		bool "Enable code that depends on avahi"
		default n

	config PIPEWIRE_DBUS
		bool "Enable code that depends on dbus"
		default y

	config PIPEWIRE_PIPEWIRE_EXAMPLES
		bool "Build examples"
		default n

	config PIPEWIRE_UDEV
		bool "Enable Udev integration"
		default y

	config PIPEWIRE_RAOP
		bool "Enable module for Remote Audio Output Protocol"
		default y

comment "Libs"

	config PIPEWIRE_LIBSNDFILE
		bool "Enable code that depends on libsndfile"
		default y

	config PIPEWIRE_LIBUSB
		bool "Enable code that depends on libusb"
		default n

	config PIPEWIRE_PULSEAUDIO
		bool "Enable code that depends on libpulse"
		default n

comment "Plugins"

	config PIPEWIRE_ALSA_LIB
		bool "Enable alsa spa plugin & pipewire-alsa integrations"
		default y

	config PIPEWIRE_FFMPEG
		bool "Enable ffmpeg spa plugin integration"
		default y

#	kernels are too old
#	config PIPEWIRE_PIPEWIRE_V4L2
#		bool "Enable v4l2 spa plugin integration"
#		default n

endif
```

## mmedia/vlc/Config.in
```kconfig
if PACKAGE_libvlc-plugins

comment "Optional Features and Packages:"

config VLC_DBUS
		bool "D-Bus message bus support"
		default n

comment "Optimization Options"

config VLC_OPTIMIZE_SPEED
		bool "compiler optimizations (-O3)"

config VLC_LUA
		bool "LUA scripting support"
		default y

comment "Input plugins:"

config VLC_LIBARCHIVE
		bool "libarchive support"
		default n

config VLC_LIVE555
		bool "RTSP input through live555"
		default n

#config VLC_LIBDVDREAD
#		bool "dvdread input module"
#		default n

#config VLC_LIBDVDNAV
#		bool "DVD with navigation input module (dvdnav)"
#		default n

#config VLC_LIBBLURAY
#		bool "libbluray for Blu-ray disc support"
#		default n

#config VLC_OPENCV3
#		bool "OpenCV (computer vision) filter"
#		default n

config VLC_SAMBA4
		bool "SMB/CIFS support"
		default n

config VLC_LIBSSH2
		bool "support SFTP file transfer via libssh2"
		default n

config VLC_LIBNFS
		bool "support NFS protocol via libnfs"
		default n

config VLC_LIBV4L
		bool "Video4Linux version 2"
		default n

#config VLC_LIBCDDB
#		bool "CDDB for Audio CD"
#		default n

#config VLC_LIBVNCSERVER
#		bool "VNC/rfb client support"
#		default n

#config VLC_FREERDP
#		bool "RDP/Remote Desktop client support"
#		default n

comment "Mux/Demux plugins:"

#config VLC_LIBDVBPSI
#		bool "dvbpsi support"
#		default n

#config VLC_LIBSIDPLAY2
#		bool "C64 sid demux support"
#		default n

config VLC_LIBOGG
		bool "Ogg demux support"
		default n

config VLC_LIBMATROSKA
		bool "MKV format support"
		default n

#config VLC_LIBMODPLUG
#		bool "Use libmodplug"
#		default n

config VLC_MUSEPACK
		bool "Use libmpcdec"
		default n

comment "Codec plugins:"

config VLC_LIBMAD
		bool "libmad module"
		default n

config VLC_MPG123
		bool "libmpg123 decoder support"
		default n

config VLC_GST1_PLUGINS_BASE
		bool "GStreamer based decoding support"
		select PACKAGE_gstreamer1-plugins-base
		select PACKAGE_libgst1app
		select PACKAGE_libgst1video
		default n

config VLC_FFMPEG
		bool "merge FFmpeg-based plugins"
		select PACKAGE_libffmpeg-full
		default n

config VLC_FFMPEG_AVCODEC
		bool "libavcodec codec"
		depends on VLC_FFMPEG_AVFORMAT
		default n

config VLC_FFMPEG_AVFORMAT
		bool "libavformat containers"
		depends on VLC_FFMPEG
		default n

config VLC_FFMPEG_SWSCALE
		bool "libswscale image scaling and conversion"
		depends on VLC_FFMPEG_AVCODEC
		default n

config VLC_FFMPEG_POSTPROC
		bool "libpostproc image post-processing"
		depends on VLC_FFMPEG
		default n

config VLC_FAAD
		bool "faad codec"
		default n

#config VLC_LIBVA
#		bool "VAAPI GPU decoding support"
#		default n

#config VLC_DAV1D
#		bool "AV1 decoder"
#		default n

config VLC_LIBVPX
		bool "libvpx VP8/VP9 encoder and decoder"
		default n

config VLC_FLAC
		bool "libflac decoder/encoder support"
		default n

config VLC_LIBMPEG2
		bool "libmpeg2 decoder support"
		default n

config VLC_LIBVORBIS
		bool "Vorbis decoder and encoder"
		default n

config VLC_TREMOR
		bool "Tremor decoder support"
		default n

config VLC_SPEEX
		bool "Speex support"
		default n

config VLC_OPUS
		bool "Opus support"
		default n


config VLC_LIBTHEORA
		bool "experimental theora codec"
		default n

config VLC_OGGSPOTS
		bool "experimental OggSpots codec"
		default n

config VLC_LIBPNG
		bool "PNG support"
		default n

config VLC_LIBJPEG
		bool "JPEG support"
		default n

config VLC_X264
		bool "H264 encoding support with libx264"
		select PACKAGE_libx264
		default n

config VLC_X26410b
		bool "H264 10-bit encoding support with libx264"
		depends on VLC_X264
		default n

#config VLC_X265
#		bool "HEVC/H.265 encoder"
#		default n

#config VLC_FLUIDSYNTH
#		bool "MIDI synthetiser with libfluidsynth"
#		default n

config VLC_LIBASS
		bool "Subtitle support using libass"
		default n

comment "Video plugins:"

#config VLC_SDL_IMAGE
#		bool "SDL image support"
#		default n

config VLC_FRIBIDI
		bool "fribidi support"
		default n

config VLC_FREETYPE
		bool "freetype support"
		default n

config VLC_HARFBUZZ
		bool "harfbuzz support"
		select HARFBUZZ_FREETYPE
		default n

config VLC_FONTCONFIG
		bool "fontconfig support"
		depends on VLC_FREETYPE
		default n

#config VLC_LIBRSVG
#		bool "SVG rendering library"
#		default n

comment "Audio plugins:"

config VLC_PULSEAUDIO
		bool "use the PulseAudio client library"
		default n

config VLC_ALSA_LIB
		bool "support the Advanced Linux Sound Architecture"
		default y

config VLC_LIBSAMPLERATE
		bool "Resampler with libsamplerate"
		default n

config VLC_LIBSOXR
		bool "SoX Resampler library"
		default n

config VLC_SNDIO
		bool "support the OpenBSD sndio"
		default n

comment "Interface plugins:"

config VLC_NCURSES
		bool "ncurses text-based interface"
		default y

comment "Service Discovery plugins:"

config VLC_LIBAVAHI_CLIENT
		bool "Zeroconf services discovery"
		default n

config VLC_UDEV
		bool "Linux udev services discovery"
		default n

config VLC_LIBUPNP
		bool "Intel UPNP SDK"
		default n

comment "Misc options:"

config VLC_LIBXML2
		bool "libxml2 support"
		default y

config VLC_LIBGCRYPT
		bool "gcrypt support"
		default n

config VLC_GNUTLS
		bool "GNU TLS TLS/SSL support"
		default n

config VLC_TAGLIB
		bool "use TagLib"
		default n

#config VLC_LIBSECRET
#		bool "use libsecret for keystore"
#		default n

endif
```

## nginx-unit/Config.in
```kconfig
#
# This is free software, licensed under the GNU General Public License v2.
# See /LICENSE for more information.
#

menu "Configuration"

config NGINX_UNIT_OPENSSL
	bool
	prompt "Enable OpenSSL"
	help
		Enabled OpenSSL support.
	default n

#config NGINX_UNIT_GO
#	bool
#	prompt "Enable Go module"
#	help
#		Go module for NGINX Unit.
#	default n

config NGINX_UNIT_PERL
	bool
	prompt "Enable Perl module"
	help
		Perl module for NGINX Unit.
	default n

config NGINX_UNIT_PHP
	bool
	prompt "Enable PHP module"
	help
		PHP module for NGINX Unit.
	default n

config NGINX_UNIT_PYTHON
	bool
	prompt "Enable Python module"
	help
		Python 2.7 module for NGINX Unit.
	default n

config NGINX_UNIT_PYTHON3
	bool
	prompt "Enable Python3 module"
	help
		Python 3.7 module for NGINX Unit.
	default n

config NGINX_UNIT_RUBY
	bool
	prompt "Enable Ruby module"
	help
		Ruby module for NGINX Unit.
	default n

endmenu
```

## sound/snapcast/Config.in
```kconfig
if PACKAGE_snapcast-server

comment "Build Options"

	config SNAPCAST_AVAHI
		bool "Build with AVAHI support"
		default n

	config SNAPCAST_EXPAT
		bool "Build with EXPAT support"
		default y

	config SNAPCAST_FLAC
		bool "Build with FLAC support"
		default y

	config SNAPCAST_OPUS
		bool "Build with OPUS support"
		default y

	config SNAPCAST_PULSE
		bool "Build with PulseAudio support"
		default n

	config SNAPCAST_TREMOR
		bool "Build with vorbis using TREMOR"
		depends on SNAPCAST_VORBIS
		default n

	config SNAPCAST_VORBIS
		bool "Build with VORBIS support"
		default y

endif
```

## utils/geoip/Config.in
```kconfig
if PACKAGE_geoip

comment "Databases:"

config GEOIP_GEOIP
	depends on PACKAGE_geoip
	bool "GeoIP         (+ ~584K)"
	default n

config GEOIP_GEOIPV6
	depends on PACKAGE_geoip
	bool "GeoIPv6       (+ ~1.1M)"
	default n

config GEOIP_GEOLITECITY
	depends on PACKAGE_geoip
	bool "GeoLiteCity   (+ ~20M)"
	default n

config GEOIP_GEOLITECITYV6
	depends on PACKAGE_geoip
	bool "GeoLiteCityv6 (+ ~16M)"
	default n

endif
```
